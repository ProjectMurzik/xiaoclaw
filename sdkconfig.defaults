## sdkconfig.defaults
```kconfig
# Target
CONFIG_IDF_TARGET="esp32p4"
CONFIG_IDF_TARGET_ESP32P4=y
CONFIG_ESP32P4_REV_MIN_0=y

# Flash & PSRAM
CONFIG_ESPTOOLPY_FLASHSIZE_32MB=y
CONFIG_SPIRAM=y
CONFIG_SPIRAM_TYPE_AUTO=y
CONFIG_SPIRAM_SPEED_200M=y
CONFIG_SPIRAM_USE_MALLOC=y
CONFIG_SPIRAM_XIP_FROM_PSRAM=y
CONFIG_SPIRAM_MALLOC_ALWAYSINTERNAL=4096
CONFIG_SPIRAM_MALLOC_RESERVE_INTERNAL=65536
CONFIG_SPIRAM_TRY_ALLOCATE_WIFI_LWIP=y
CONFIG_MBEDTLS_EXTERNAL_MEM_ALLOC=y

# Partition Table
CONFIG_PARTITION_TABLE_CUSTOM=y
CONFIG_PARTITION_TABLE_CUSTOM_FILENAME="partitions.csv"
CONFIG_PARTITION_TABLE_OFFSET=0x10000
CONFIG_PARTITION_TABLE_MD5=y

# Board
CONFIG_BOARD_TYPE_WAVESHARE_ESP32_P4_WIFI6_TOUCH_LCD_3_4C=y

# Display & Fonts
CONFIG_LCD_ENABLE=y
CONFIG_LCD_MIPI_DSI=y
CONFIG_LCD_MIPI_DSI_PHY_DUAL_LANE=y
CONFIG_LVGL_ENABLE=y
CONFIG_LVGL_COLOR_DEPTH=16
CONFIG_LVGL_DRAW_BUF_SIZE=200000
CONFIG_LVGL_MEM_POOL_INCLUDE_SPIRAM_HEAP=y
CONFIG_LVGL_USE_IMGFONT=n
CONFIG_LV_FONT_FMT_TXT_LARGE=y

# Audio & Speech Recognition (ESP-SR v2.*)
CONFIG_ESP_I2S_ENABLE=y
CONFIG_USE_AUDIO_PROCESSOR=y
CONFIG_ESP_SR_ENABLE=y
CONFIG_SR_MODEL_ALLOC_FROM_SPIRAM=y
CONFIG_SR_MODEL_ALLOC_MODE_MAX_ONLY=y
CONFIG_SR_WN_WN9_S8=y
CONFIG_SR_MN_MN4_S8=y
CONFIG_SR_VAD_VADNET_VAD8=y

# Wi-Fi (ESP32-C6 coprocessor)
CONFIG_SLAVE_IDF_TARGET_ESP32C6=y

# Отключаем проблемные компоненты
CONFIG_CAMERA_ENABLE=n
CONFIG_ESP_VIDEO_ENABLE=n

# Language
CONFIG_LANGUAGE_EN_US=y
CONFIG_FLASH_DEFAULT_ASSETS=n

# Compiler
CONFIG_COMPILER_OPTIMIZATION_PERF=y
CONFIG_COMPILER_WARNINGS_AS_ERRORS=n
CONFIG_COMPILER_CXX_RTTI=y
CONFIG_COMPILER_CXX_EXCEPTIONS=y
CONFIG_COMPILER_DISABLE_GCC8_WARNINGS=y

# Bootloader
CONFIG_BOOTLOADER_LOG_LEVEL_NONE=y
CONFIG_BOOTLOADER_COMPILER_OPTIMIZATION_SIZE=y

# FreeRTOS
CONFIG_FREERTOS_HZ=1000
CONFIG_FREERTOS_VTASKLIST_INCLUDE_COREID=y
CONFIG_FREERTOS_GENERATE_RUN_TIME_STATS=y
CONFIG_FREERTOS_SUPPORT_EXTERNAL_MEM=y

# USB
CONFIG_USB_HOST_CONTROL_TRANSFER_MAX_SIZE=1024

# System
CONFIG_ESP_MAIN_TASK_STACK_SIZE=32768

# OTA disabled
CONFIG_ENABLE_OTA=n
CONFIG_APP_OTA_ROLLBACK_ENABLE=n

# Server
CONFIG_MIMI_SERVER_URL="wss://api.xiaozhi.me:443/v1"
```
